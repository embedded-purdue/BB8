## main/Kconfig.projbuild
```kconfig
menu "BB8 Firmware"
config BB8_SAMPLE_HZ
    int "IMU sample rate (Hz)"
    range 25 1000
    default 200

choice
    prompt "Fusion algorithm"
    default BB8_FUSION_MADGWICK
    help
        Select the default orientation fusion algorithm.
config BB8_FUSION_MADGWICK
    bool "Madgwick (fast, good default)"
config BB8_FUSION_MAHONY
    bool "Mahony"
endchoice

config BB8_ENABLE_BLE
    bool "Enable BLE services (stubs)"
    default n

config BB8_ENABLE_STORAGE
    bool "Enable storage (stubs)"
    default n
endmenu
```

## sdkconfig.defaults
```kconfig
# ESP32-WROOM Configuration
# Optimized settings for ESP32-WROOM module

# Serial flasher config (ESP32-WROOM specific)
CONFIG_ESPTOOLPY_FLASHMODE_QIO=y
CONFIG_ESPTOOLPY_FLASHFREQ_80M=y
CONFIG_ESPTOOLPY_FLASHSIZE_4MB=y

# Partition Table
CONFIG_PARTITION_TABLE_SINGLE_APP=y

# Log output
CONFIG_LOG_DEFAULT_LEVEL_INFO=y
CONFIG_LOG_MAXIMUM_LEVEL_VERBOSE=y

# FreeRTOS
CONFIG_FREERTOS_HZ=1000

# GPIO (ESP32-WROOM specific)
CONFIG_GPIO_ESP32_SUPPORT_SWITCH_SLP_PULL=y

# UART
CONFIG_UART_ISR_IN_IRAM=y

# Memory (ESP32-WROOM has 4MB flash, 520KB SRAM - NO PSRAM)
CONFIG_SPIRAM_SUPPORT=n
CONFIG_SPIRAM_USE_MALLOC=n
CONFIG_SPIRAM_USE_CAPS_ALLOC=n

# WiFi (ESP32-WROOM has built-in WiFi antenna)
CONFIG_ESP_WIFI_ENABLED=y
CONFIG_ESP_WIFI_STATIC_RX_BUFFER_NUM=10
CONFIG_ESP_WIFI_DYNAMIC_RX_BUFFER_NUM=32
CONFIG_ESP_WIFI_AMPDU_TX_ENABLED=y
CONFIG_ESP_WIFI_AMPDU_RX_ENABLED=y

# Bluetooth (ESP32-WROOM supports both Classic and BLE)
# Xbox controllers require Bluetooth Classic (BR/EDR), not BLE only
# Bluepad32 uses BTstack (controller-only mode), NOT Bluedroid
CONFIG_BT_ENABLED=y
CONFIG_BT_CONTROLLER_ONLY=y
# Prefer Classic (BR/EDR) only for stability with Xbox controllers
# CONFIG_BTDM_CTRL_MODE_BTDM is not set
CONFIG_BTDM_CTRL_MODE_BR_EDR_ONLY=y
# Connection limits - should be at least one more than CONFIG_BLUEPAD32_MAX_DEVICES
CONFIG_BTDM_CTRL_BR_EDR_MAX_ACL_CONN=1
CONFIG_BTDM_CTRL_BLE_MAX_CONN=0
CONFIG_BTDM_CTRL_BR_EDR_MAX_SYNC_CONN=0
# CRITICAL: Disable modem sleep to prevent random disconnections
# This prevents the Bluetooth controller from entering sleep mode during active communication
CONFIG_BTDM_CTRL_MODEM_SLEEP=n
CONFIG_BTDM_CTRL_AUTO_LATENCY=y

# Bluepad32 Platform - Use CUSTOM platform for custom controller integration
CONFIG_BLUEPAD32_PLATFORM_CUSTOM=y
CONFIG_BLUEPAD32_MAX_DEVICES=4

# Power Management - DISABLED to prevent conflicts with Bluetooth
# Power management can cause Bluetooth controller sleep issues
# CONFIG_PM_ENABLE is not set
# CONFIG_PM_DFS_INIT_AUTO is not set

# CPU Frequency (ESP32-WROOM can run at 240MHz)
CONFIG_ESP_DEFAULT_CPU_FREQ_MHZ_240=y
CONFIG_ESP_DEFAULT_CPU_FREQ_MHZ=240
```
